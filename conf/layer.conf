## conf/layer.conf
```bitbake
# We have a conf and classes directory, add to BBPATH
BBPATH .= ":${LAYERDIR}"

# We have recipes-* directories, add to BBFILES
BBFILES += "${LAYERDIR}/recipes-*/*/*.bb \
                 ${LAYERDIR}/recipes-*/*/*.bbappend"
                 
BBFILE_COLLECTIONS += "qkd"
BBFILE_PATTERN_qkd = "^${LAYERDIR}/"
BBFILE_PRIORITY_qkd = "5"
LAYERVERSION_qkd = "3"
```
